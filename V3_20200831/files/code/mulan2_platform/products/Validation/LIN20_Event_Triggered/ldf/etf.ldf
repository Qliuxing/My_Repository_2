/*
 * Event-triggered frame example
 *
 * Copyright (C) 2007-2008 Melexis N.V.
 */
LIN_description_file;
LIN_protocol_version = "2.0";
LIN_language_version = "2.0";
LIN_speed = 9.6 kbps;

Nodes
{
    Master: UsbLinMaster, 10 ms, 1 ms;
    Slaves: Node_doorFrontLeft, Node_doorFrontRight;
}

Signals
{
    doorFrontLeft_brightLevel : 8, 0x00, UsbLinMaster, Node_doorFrontLeft;
    doorFrontLeft_timeout : 8, 0x00, UsbLinMaster, Node_doorFrontLeft;
    doorFrontLeft_brightFeedback : 8, 0x00, Node_doorFrontLeft, UsbLinMaster;

    doorFrontRight_brightLevel : 8, 0x00, UsbLinMaster, Node_doorFrontRight;
    doorFrontRight_timeout : 8, 0x00, UsbLinMaster, Node_doorFrontRight;
    doorFrontRight_brightFeedback : 8, 0x00, Node_doorFrontRight, UsbLinMaster;

    doorFrontLeft_respError : 1, 0x00, Node_doorFrontLeft, UsbLinMaster;
    doorFrontRight_respError : 1, 0x00, Node_doorFrontRight, UsbLinMaster;
}

/*
 * Notes: There are no event-triggered frames in the Frames sections,
 * since "Event triggered frames means the event triggered frame
 * header, it will therefore not contain any signals" [LIN spec]
 * Thus only associated (to ETF) unconditional frames are listed
 * in Frame section.
 */
Frames {

    doorFrontLeft_feedback : 0x21, Node_doorFrontLeft, 4
    {
        /* first data byte [0..7] is reserved for Protected ID */
        doorFrontLeft_brightFeedback, 8;
    }

    doorFrontRight_feedback : 0x22, Node_doorFrontRight, 4
    {
        /* first data byte [0..7] is reserved for Protected ID */
        doorFrontRight_brightFeedback, 8;
    }

    doorFrontLeft_setBackLight : 0x03, UsbLinMaster, 2
    {
        doorFrontLeft_brightLevel, 0;
        doorFrontLeft_timeout, 8;
    }

    doorFrontRight_setBackLight : 0x04, UsbLinMaster, 2
    {
        doorFrontRight_brightLevel, 0;
        doorFrontRight_timeout, 8;
    }

    doorFrontLeft_status : 0x01, Node_doorFrontLeft, 2
    {
        doorFrontLeft_respError, 0;
    }

    doorFrontRight_status : 0x02, Node_doorFrontRight, 2
    {
        doorFrontRight_respError, 0;
    }
}

/* TODO: LDF verification by a Tool
 * Verify that associated unconditional frames (doorFrontLeft_buttons and doorFrontRight_buttons)
 * - Have equal length
 * - Use same checksum model
 * - Reserve the first byte to Protected ID (generate an error if the frame
 * defined in Event_triggered_frames section has signals in position [0..7])
 * - published by different slave nodes (each frame from the list should belong
 * to own slave node)
 */
Event_triggered_frames {
  doorAll_feedback: 0x20, doorFrontLeft_feedback, doorFrontRight_feedback;
}

Node_attributes
{
    Node_doorFrontLeft
    {
        LIN_protocol = "2.0";
        configured_NAD = 0x31;
        product_id = 0x5AFE, 0x1000, 1;
        response_error = doorFrontLeft_respError;
        P2_min = 20 ms; /* TBD */
        ST_min = 20 ms; /* TBD */
        configurable_frames
        {
            doorFrontLeft_status = 0x4051;
            doorFrontLeft_feedback = 0x40C1;
            doorAll_feedback = 0x40C0;
            doorFrontLeft_setBackLight = 0x40D1;
        }
    }

    Node_doorFrontRight
    {
        LIN_protocol = "2.0";
        configured_NAD = 0x32;
        product_id = 0x5AFE, 0x1000, 1;
        response_error = doorFrontRight_respError;
        P2_min = 20 ms; /* TBD */
        ST_min = 20 ms; /* TBD */
        configurable_frames
        {
            doorFrontRight_status = 0x4151;
            doorFrontRight_feedback = 0x41C1;
            doorAll_feedback = 0x41C0;
            doorFrontRight_setBackLight = 0x41D1;
        }
    }

}

Schedule_tables {
    /* TBD */
    normal_mode
    {
        doorFrontLeft_status delay 20 ms;
        doorFrontRight_status delay 20 ms;
    }
    config_mode
    {
        AssignNAD {0x01, 0x31, 0x5AFE, 0x1000} delay 20.000 ms; /* Request is addressed to initial NAD */
        FreeFormat {0x7F, 0x06, 0xB3, 0, 5, 0xFF, 0x01, 0x31} delay 20.000 ms; /* Conditional change NAD request */

        AssignFrameId{Node_doorFrontLeft, doorFrontLeft_status} delay 20.000 ms;
        AssignFrameId{Node_doorFrontLeft, doorFrontLeft_feedback} delay 20.000 ms;
        AssignFrameId{Node_doorFrontLeft, doorAll_feedback} delay 20.000 ms;
        AssignFrameId{Node_doorFrontLeft, doorFrontLeft_setBackLight} delay 20.000 ms;
    }
}
